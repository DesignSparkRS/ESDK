/*
 * Device Tree Overlay for ESDK RTC on I2C0
 * RS Components 2021
 */

 /dts-v1/;
 /plugin/;

 / {
 	compatible = "brcm,bcm2835", "brcm,bcm2708", "brcm,bcm2709";

 	fragment@0 {
 		target = <&i2c0>;
 		__overlay__ {
 			#address-cells = <1>;
 			#size-cells = <0>;

 			ds1307: ds1307@68 {
 				compatible = "dallas,ds1307";
 				reg = <0x68>;
 			};
 		};
 	};
 };